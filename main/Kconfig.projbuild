## main/Kconfig.projbuild
```kconfig
menu "TH2822 panel"
config PANEL_ROTATE_180
    bool "Rotate display and touch by 180 degrees"
    default n
config PANEL_USB_HOST_ENABLED
    bool "Enable native USB host (verify VBUS wiring first)"
    default y
endmenu
```

## sdkconfig.defaults
```kconfig
CONFIG_IDF_TARGET="esp32s3"
CONFIG_ESPTOOLPY_FLASHSIZE_16MB=y
CONFIG_PARTITION_TABLE_SINGLE_APP_LARGE=y
CONFIG_SPIRAM=y
CONFIG_SPIRAM_MODE_OCT=y
CONFIG_SPIRAM_SPEED_80M=y
CONFIG_SPIRAM_FETCH_INSTRUCTIONS=y
CONFIG_SPIRAM_RODATA=y
CONFIG_ESP_DEFAULT_CPU_FREQ_MHZ_240=y
CONFIG_ESP_CONSOLE_UART_DEFAULT=y
CONFIG_FREERTOS_HZ=1000
CONFIG_LV_FONT_MONTSERRAT_20=y
CONFIG_LV_FONT_MONTSERRAT_24=y
CONFIG_LV_FONT_MONTSERRAT_32=y
CONFIG_LV_FONT_MONTSERRAT_48=y
CONFIG_LV_FONT_MONTSERRAT_40=y
CONFIG_LV_USE_DEMO_WIDGETS=n

CONFIG_LV_FONT_MONTSERRAT_16=y

CONFIG_ESP32S3_DATA_CACHE_LINE_64B=y

CONFIG_ESP32S3_DATA_CACHE_64KB=y

# CONFIG_LCD_RGB_RESTART_IN_VSYNC is not set

# CONFIG_LCD_RGB_ISR_IRAM_SAFE is not set
```
